## board/boundary/imx91_tap2id/Kconfig
```kconfig
if TARGET_IMX91_TAP2ID

config SYS_BOARD
	default "imx91_tap2id"

config SYS_VENDOR
	default "boundary"

config SYS_CONFIG_NAME
	default "imx91_tap2id"

choice
	prompt "Select DDR Type"
	default IMX91_TAP2ID_LPDDR4 if TARGET_IMX91_TAP2ID

config IMX91_TAP2ID_LPDDR4
	bool "Using LPDDR4 Timing and PMIC voltage"
	# IMX9_LPDDR4X is used for LPDDR4 AND LPDDR4X
	select IMX9_LPDDR4X
	help
	  Select the LPDDR4 timing and 1.1V VDDQ

endchoice

source "board/boundary/common/Kconfig"
endif
```

## configs/imx91_nitrogen_smarc_512_defconfig
```kconfig
#include <configs/imx91_nitrogen_smarc_defconfig>

CONFIG_IMX91_NITROGEN_SMARC_512=y
```
